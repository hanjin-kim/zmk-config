/ {
  chosen { 
    zmk,battery = &vbatt;
  };
  
  vbatt: vbatt {
    compatible = "zmk,battery-voltage-divider";
    label = "BATTERY";
    io-channels = <&adc 2>;
    output-ohms =<2000000>;
    full-ohms = <(2000000 +806000)>;
  };
};
