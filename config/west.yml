## config/west.yml
```yaml
manifest:
  remotes:
    - name: zmkfirmware
      url-base: https://github.com/hanjin-kim
  projects:
    - name: zmkfirmwares
      remote: zmkfirmware
      revision: for-colemak-on-mac
      import: config/west.yml
  self:
    path: config
```
